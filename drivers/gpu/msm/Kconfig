## drivers/gpu/msm/Kconfig
```kconfig
choice
	prompt "Qualcomm Adreno proprietary stack version"

config QCOM_KGSL_CURRENT
	bool "Use regular KGSL stack"

config QCOM_KGSL_LEGACY
	bool "Use legacy KGSL stack"
endchoice

source drivers/gpu/msm_legacy/Kconfig

menu "Qualcomm Adreno proprietary stack"
	depends on QCOM_KGSL_CURRENT

config QCOM_KGSL
	tristate "Qualcomm Technologies, Inc. 3D Graphics driver"
	default n
	depends on ARCH_QCOM
	select GENERIC_ALLOCATOR
	select FW_LOADER
	select PM_DEVFREQ
	select DEVFREQ_GOV_SIMPLE_ONDEMAND
	select DEVFREQ_GOV_PERFORMANCE
	select DEVFREQ_GOV_QCOM_ADRENO_TZ
	select DEVFREQ_GOV_QCOM_GPUBW_MON
	---help---
	  3D graphics driver for the Adreno family of GPUs from QTI.
	  Required to use hardware accelerated OpenGL, compute and Vulkan
	  on QTI targets. This includes power management, memory management,
	  and scheduling for the Adreno GPUs.

config QCOM_ADRENO_DEFAULT_GOVERNOR
	string "devfreq governor for the adreno core"
	default "msm-adreno-tz" if DEVFREQ_GOV_QCOM_ADRENO_TZ
	default "simple_ondemand"
	depends on QCOM_KGSL

config QCOM_KGSL_IOMMU
	bool
	default y if QCOM_KGSL && (MSM_IOMMU || ARM_SMMU)

endmenu
```

## drivers/input/touchscreen/cyttsp5/Kconfig
```kconfig
#
# Touchscreen driver configuration
#
config TOUCHSCREEN_CYPRESS_CYTTSP5
	tristate "Cypress TrueTouch Gen5 Touchscreen Driver"
	default n
	help
	  Core driver for Cypress TrueTouch(tm) Standard Product
	  Geneartion5 touchscreen controllers.

	  Say Y here if you have a Cypress Gen5 touchscreen.

	  If unsure, say N.

	  To compile this driver as a module, choose M here: the
	  module will be called cyttsp5.

config TOUCHSCREEN_CYPRESS_CYTTSP5_DEVICETREE_SUPPORT
	bool "Enable Device Tree support"
	default n
	depends on TOUCHSCREEN_CYPRESS_CYTTSP5 && OF
	help
	  Say Y here to enable support for device tree.

	  If unsure, say N.

config TOUCHSCREEN_CYPRESS_CYTTSP5_DEBUG
	bool "Enable debug output"
	depends on TOUCHSCREEN_CYPRESS_CYTTSP5
	default n
	help
	  Say Y here to enable debug output for Cypress TrueTouch(tm)
	  Standard Product Generation5 drivers set.

	  If unsure, say N.

config TOUCHSCREEN_CYPRESS_CYTTSP5_VDEBUG
	bool "Enable verbose debug output"
	depends on TOUCHSCREEN_CYPRESS_CYTTSP5_DEBUG
	default n
	help
	  Say Y here to enable verbose debug output for Cypress TrueTouch(tm)
	  Standard Product Generation5 drivers set.

	  If unsure, say N.

config TOUCHSCREEN_CYPRESS_CYTTSP5_I2C
	tristate "Cypress TrueTouch Gen5 I2C"
	depends on TOUCHSCREEN_CYPRESS_CYTTSP5
	select I2C
	default n
	help
	  Say Y here to enable I2C bus interface to Cypress TrueTouch(tm)
	  Standard Product Generation5 touchscreen controller.

	  If unsure, say Y.

	  To compile this driver as a module, choose M here: the
	  module will be called cyttsp5_i2c.

choice
	bool "Cypress TrueTouch Gen5 MultiTouch Protocol"
	depends on TOUCHSCREEN_CYPRESS_CYTTSP5
	default TOUCHSCREEN_CYPRESS_CYTTSP5_MT_B
	help
	  This option controls which MultiTouch protocol will be used to
	  report the touch events.

config TOUCHSCREEN_CYPRESS_CYTTSP5_MT_A
	bool "Protocol A"
	help
	  Select to enable MultiTouch touch reporting using protocol A
	  on Cypress TrueTouch(tm) Standard Product Generation4 touchscreen
	  controller.

config TOUCHSCREEN_CYPRESS_CYTTSP5_MT_B
	bool "Protocol B"
	help
	  Select to enable MultiTouch touch reporting using protocol B
	  on Cypress TrueTouch(tm) Standard Product Generation4 touchscreen
	  controller.

endchoice

config TOUCHSCREEN_CYPRESS_CYTTSP5_LOADER
	tristate "Cypress TrueTouch Gen5 MultiTouch Loader"
	depends on TOUCHSCREEN_CYPRESS_CYTTSP5
	default n
	help
	  Say Y here to enable Cypress TrueTouch(tm) Standard Product
	  Generation5 touchscreen controller FW Loader module.

	  This module enables support for Firmware upgrade.

	  If unsure, say Y.

	  To compile this driver as a module, choose M here: the
	  module will be called cyttsp5_loader.

config TOUCHSCREEN_CYPRESS_CYTTSP5_PLATFORM_FW_UPGRADE
	bool "FW upgrade from header file"
	depends on TOUCHSCREEN_CYPRESS_CYTTSP5_LOADER
	default n
	help
	  Say Y here to include Cypress TrueTouch(tm) Standard Product
	  Generation5 device Firmware into driver.

	  Need proper header file for this.

	  If unsure, say N.

config TOUCHSCREEN_CYPRESS_CYTTSP5_BINARY_FW_UPGRADE
	bool "FW upgrade from binary file"
	depends on TOUCHSCREEN_CYPRESS_CYTTSP5_LOADER
	default n
	help
	  Say Y here to include Cypress TrueTouch(tm) Standard Product
	  Generation5 device Firmware into kernel as binary blob.

	  This should be enabled for manual FW upgrade support.

	  If unsure, say Y.

config TOUCHSCREEN_CYPRESS_CYTTSP5_PLATFORM_TTCONFIG_UPGRADE
	bool "TT Configuration upgrade from header file"
	depends on TOUCHSCREEN_CYPRESS_CYTTSP5_LOADER
	default n
	help
	  Say Y here to include Cypress TrueTouch(tm) Standard Product
	  Generation5 device TrueTouch Configuration into kernel itself.

	  Need proper header file for this.

	  If unsure, say N.

config TOUCHSCREEN_CYPRESS_CYTTSP5_MANUAL_TTCONFIG_UPGRADE
	bool "TT Configuration upgrade via SysFs"
	depends on TOUCHSCREEN_CYPRESS_CYTTSP5_LOADER
	default n
	help
	  Say Y here to provide a SysFs interface to upgrade TrueTouch
	  Configuration with a binary configuration file.

	  Need proper binary version of config file for this
	  feature.

	  If unsure, say Y.

config TOUCHSCREEN_CYPRESS_CYTTSP5_DEBUG_MDL
	tristate "Cypress TrueTouch Gen5 MultiTouch Debug Module"
	depends on TOUCHSCREEN_CYPRESS_CYTTSP5
	default n
	help
	  Say Y here to enable Cypress TrueTouch(tm) Standard Product
	  Generation5 Debug module.

	  This module adds support for verbose printing touch
	  information.

	  If unsure, say N.

	  To compile this driver as a module, choose M here: the
	  module will be called cyttsp5_debug.
```

## drivers/misc/dts_eagle/Kconfig
```kconfig
config DTS_EAGLE
	tristate "DTS Eagle driver"
	depends on ARCH_MSM
	default n
	help
	  Eagle is a DTS pre/post processing
	  package that includes HeadphoneX. The configuration
	  includes sending tuning parameters of various modules.
```
