/* Copyright (c) 2018, The Linux Foundation. All rights reserved.
 *
 * This program is free software; you can redistribute it and/or modify
 * it under the terms of the GNU General Public License version 2 and
 * only version 2 as published by the Free Software Foundation.
 *
 * This program is distributed in the hope that it will be useful,
 * but WITHOUT ANY WARRANTY; without even the implied warranty of
 * MERCHANTABILITY or FITNESS FOR A PARTICULAR PURPOSE.  See the
 * GNU General Public License for more details.
 */

/dts-v1/;

#include "msm8939.dtsi"
#include "msm8939-pinctrl.dtsi"
#include "msm8939-audio.dtsi"
#include "msm8939-kanuti-tulip.dtsi"
//#include "msm8939-kanuti-tulip_camera.dtsi"
#include "dsi-panel-somc-tulip.dtsi"

/ {
	model = "SoMC Tulip SMB1360";
	compatible = "qcom,msm8939-mtp", "qcom,msm8939", "qcom,mtp",
			"somc,kanuti", "somc,tulip";
	qcom,board-id = <8 0>;
};
