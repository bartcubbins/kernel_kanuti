#include <dt-bindings/interrupt-controller/arm-gic.h>

&soc {

	apps_iommu: qcom,iommu@1e00000 {
		compatible = "qcom,qsmmu-v500";
		reg = <0x1e00000 0x40000>,
			<0x1ef2000 0x20>;
		reg-names = "base", "tcu-base";
		#iommu-cells = <2>;
		qcom,tz-device-id = "APPS";
		qcom,skip-init;
		qcom,enable-static-cb;
		qcom,use-3-lvl-tables;
		qcom,disable-atos;
		#global-interrupts = <0>;
		#size-cells = <1>;
		#address-cells = <1>;
		ranges;
		interrupts = <GIC_SPI 53 IRQ_TYPE_LEVEL_HIGH>,     /* jpeg_enc0 */
				<GIC_SPI 54 IRQ_TYPE_LEVEL_HIGH>,  /* vfe */
				<GIC_SPI 58 IRQ_TYPE_LEVEL_HIGH>,  /* mdp_0 */
				<GIC_SPI 60 IRQ_TYPE_LEVEL_HIGH>,  /* venus_ns */
				<GIC_SPI 61 IRQ_TYPE_LEVEL_HIGH>,  /* cpp */
				<GIC_SPI 76 IRQ_TYPE_LEVEL_HIGH>,  /* mDSP */
				<GIC_SPI 77 IRQ_TYPE_LEVEL_HIGH>,  /* gss */
				<GIC_SPI 80 IRQ_TYPE_LEVEL_HIGH>,  /* a2 */
				<GIC_SPI 110 IRQ_TYPE_LEVEL_HIGH>, /* mdp_1 */
				<GIC_SPI 111 IRQ_TYPE_LEVEL_HIGH>, /* venus_sec_pixel */
				<GIC_SPI 112 IRQ_TYPE_LEVEL_HIGH>, /* venus_sec_bitstream */
				<GIC_SPI 113 IRQ_TYPE_LEVEL_HIGH>, /* venus_sec_non_pixel */
				<GIC_SPI 114 IRQ_TYPE_LEVEL_HIGH>, /* venus_fw */
				<GIC_SPI 115 IRQ_TYPE_LEVEL_HIGH>, /* periph_rpm */
				<GIC_SPI 116 IRQ_TYPE_LEVEL_HIGH>, /* periph_CE */
				<GIC_SPI 117 IRQ_TYPE_LEVEL_HIGH>, /* periph_BLSP */
				<GIC_SPI 118 IRQ_TYPE_LEVEL_HIGH>, /* periph_SDC1 */
				<GIC_SPI 119 IRQ_TYPE_LEVEL_HIGH>, /* periph_SDC2 */
				<GIC_SPI 120 IRQ_TYPE_LEVEL_HIGH>, /* periph_audio */
				<GIC_SPI 121 IRQ_TYPE_LEVEL_HIGH>; /* periph_USB_HS1 */

clocks =
				<&clock_gcc clk_gcc_smmu_cfg_clk>,
				<&clock_gcc clk_gcc_apss_tcu_clk>;
			clock-names = "iface_clk", "core_clk";
	};

};
